## linux/linux-2.6.32.32/drivers/net/Kconfig.rtl
```kconfig
#
# Ethernet LAN device configuration for RealTek
#

source "drivers/net/rtl8367_switch_api/Kconfig"
```

## linux/linux-2.6.32.32/drivers/net/rtl8367_switch_api/Kconfig
```kconfig
#
# Ethernet LAN device configuration
#

config LANTIQ_MDIO
		bool "Lantiq MDIO Used"
		default y

config NET_VENDOR_REALTEK
         bool "Realtek devices"
         default y
         ---help---
           	If you have a Realtek network (Ethernet) card belonging to this class, say Y

if NET_VENDOR_REALTEK
source "drivers/net/rtl8367_switch_api/realtek/Kconfig"
endif # NET_VENDOR_REALTEK
```

## linux/linux-2.6.32.32/drivers/net/rtl8367_switch_api/realtek/Kconfig
```kconfig
#
# Realtek device configuration
#

config RTL8367RB
         tristate "Realtek 8367RB gigabit ethernet support"
         depends on NET_VENDOR_REALTEK
         default y
         ---help---
           Say Y here if you have a Realtek 8367 Gigabit Ethernet Switch.

if RTL8367RB

#config RTL8367RB_IOCTL_DBG
#         tristate "Realtek 8367RB ioctl debug"
#         default y

choice
		prompt "APIs version support"
			depends on RTL8367RB
			default RTL8367RB_APIs_v1_2_10

		config RTL8367RB_APIs_v1_2_10
			bool "Switch API v1.2.10 support"
			---help---
		  		Unmanaged switch APIs driver v1.2.10 release.

		config RTL8367RB_APIs_v1_2_11
			bool "Switch API v1.2.11 support"
			---help---
		  		Unmanaged switch APIs driver v1.2.11 release.
endchoice

endif # RTL8367RB
```

## package/infineon-utilities/feeds/feed_opensource_apps/br2684ctl/config/Config.in
```kconfig
config FEATURE_IFX_VLAN
	bool 'WAN VLAN Tagging Support'
	help
	  Support for WAN VLAN Tagging
```

## package/infineon-utilities/feeds/ifx_dsl_cpe/ifx-dsl-cpe-api-vrx/Config.in
```kconfig
menu "Configuration"
	depends on PACKAGE_ifx-dsl-cpe-api-vrx
	config IFX_VRX_CHANNELS_PER_LINE
		string
		prompt "Number of channels per VRX line"
		default "1"
		help
		  Defines the max. possible number of logical (bearer) channels.
		  Currently only 1 channel is supported.

	choice
		prompt "build model"
		default ifx-dsl-cpe-api-vrx_MODEL_FULL
		help
		  Selection of a model (predefined combination of configure options).

	config ifx-dsl-cpe-api-vrx_MODEL_LITE
		bool "Lite"
		help
		  Minimum features included.
		  This model should ONLY demonstrate the minimum possible size.

	config ifx-dsl-cpe-api-vrx_MODEL_FOOTPRINT
		bool "Footprint"
		help
		  Defined for low footprint applications.

	config ifx-dsl-cpe-api-vrx_MODEL_TYPICAL
		bool "Typical"
		help
		  Defined for most typical use.

	config ifx-dsl-cpe-api-vrx_MODEL_FULL
		bool "Full"
		help
		  Includes all features but NOT all debug functionalities.

	config ifx-dsl-cpe-api-vrx_MODEL_DEBUG
		bool "Debug"
		help
		  Includes all features AND debug functionalities.
	endchoice

	menu "optional build options"
		depends on PACKAGE_ifx-dsl-cpe-api-vrx
	config ifx-dsl-cpe-api-vrx_USE_ADDITIONAL_BUILD_OPTIONS
		depends on PACKAGE_ifx-dsl-cpe-api-vrx
		bool "Use additional build options"
		default n
		help
		  Provides the possibility to include/exclude single features directly.
		  This configuration overwrites selections which are done by the "build model" configuration.

	config ifx-dsl-cpe-api-vrx_ADDITIONAL_BUILD_OPTIONS
		depends on ifx-dsl-cpe-api-vrx_USE_ADDITIONAL_BUILD_OPTIONS
		string "Additional build options"
		help
		  Defines to include/exclude single feature using available configure options.
		  Please refer to the documentation of the DSL CPE API "Configure options for the DSL CPE API"
	endmenu
endmenu
```

## package/infineon-utilities/feeds/ifx_dsl_cpe/ifx-dsl-cpe-control-vrx/Config.in
```kconfig
menu "Configuration"
	depends on PACKAGE_ifx-dsl-cpe-control-vrx

	config ifx-dsl-cpe-control-vrx_DTI
		bool "Include DTI"
		select PACKAGE_lib-dti
		default n
		help
		  Defines to include/exclude the Debug & Trace Interface.

	choice
		prompt "build model"
		default ifx-dsl-cpe-control-vrx_MODEL_FOOTPRINT
		help
		  Selection of a model (predefined combination of configure options).

	config ifx-dsl-cpe-control-vrx_MODEL_LITE
		bool "Lite"
		help
		  Minimum features included.
		  This model should ONLY demonstrate the minimum possible size.

	config ifx-dsl-cpe-control-vrx_MODEL_FOOTPRINT
		bool "Footprint"
		select ifx-dsl-cpe-control-vrx_DTI
		help
		  Defined for low footprint applications.

	config ifx-dsl-cpe-control-vrx_MODEL_TYPICAL
		bool "Typical"
		select ifx-dsl-cpe-control-vrx_DTI
		help
		  Defined for most typical use.

	config ifx-dsl-cpe-control-vrx_MODEL_FULL
		bool "Full"
		select ifx-dsl-cpe-control-vrx_DTI
		help
		  Includes all features but NOT all debug functionalities.

	config ifx-dsl-cpe-control-vrx_MODEL_DEBUG
		bool "Debug"
		select ifx-dsl-cpe-control-vrx_DTI
		help
		  Includes all features AND debug functionalities.
	endchoice

	menu "optional build options"
		depends on PACKAGE_ifx-dsl-cpe-control-vrx
	config ifx-dsl-cpe-control-vrx_USE_ADDITIONAL_BUILD_OPTIONS
		bool "Use additional build options"
		default n
		help
		  Provides the possibility to include/exclude single features directly.
		  This configuration overwrites selections which are done by the "build model" configuration.

	config ifx-dsl-cpe-control-vrx_ADDITIONAL_BUILD_OPTIONS
		depends on ifx-dsl-cpe-control-vrx_USE_ADDITIONAL_BUILD_OPTIONS
		string "Additional build options"
		help
		  Defines to include/exclude single feature using available configure options.
		  Please refer to the documentation of the DSL CPE API "Configure options for the DSL CPE API"

	endmenu
endmenu
```

## package/infineon-utilities/feeds/ifx_voice_cpe/ifx-voice-cpe-tapi/config/Config.in
```kconfig
menu "advanced configuration (for developers)"
   depends on PACKAGE_ifx-voice-cpe-tapi
config  LTQ_VOICE_CPE_TAPI_ADDITIONAL_FLAGS
	string "additional configuration arguments"
	depends on PACKAGE_ifx-voice-cpe-tapi
	default ""
	help
		additional configuration arguments (for developers)
endmenu

config LTQ_VOICE_CPE_TAPI_FAX
	bool "fax relay and modem support"
	depends on PACKAGE_ifx-voice-cpe-tapi
	default n
	help
		Option to enable fax/modem support in TAPI.
		Note: Newer platforms as AR9 and VR9 support a T.38 fax relay stack
		in FW while older platforms like Danube or VINETIC-CPE require a
		separate SW stack executed as an application.

config LTQ_VOICE_CPE_TAPI_CID
	bool "CID support"
	depends on PACKAGE_ifx-voice-cpe-tapi
	default y
	help
		Option to enable Caller ID support.

config LTQ_VOICE_CPE_TAPI_LT_GR909
	bool "Linetesting GR-909 support"
	depends on PACKAGE_ifx-voice-cpe-tapi
	default y
	   help
		   Option to enable linetesting GR-909.

config LTQ_VOICE_CPE_TAPI_DECT
	bool "DECT encoding for COSIC modem"
	depends on PACKAGE_ifx-voice-cpe-tapi
	default n
		help
			Option to enable DECT encoding for COSIC modem.

config LTQ_VOICE_CPE_TAPI_KPI
	bool "KPI (Kernel Packet Interface)"
	depends on PACKAGE_ifx-voice-cpe-tapi
	default y
	help
		Option to enable the generic kernel level packet interface
		which allows accelerated packet transfer for various purposes.
		The most important example is the QOS option, which allows
		to redirect RTP packets directly into the IP stack.
		Other options relying on KPI are DECT and HDLC.

config LTQ_VOICE_CPE_TAPI_QOS
	bool "QOS for accelerated RTP packet handling"
	depends on PACKAGE_ifx-voice-cpe-tapi
	default y
	help
		Option to enable an accelerated RTP packet transfer inside
		the LINUX kernel space. This option requires the KPI2UDP
		packet, which actually provides the OS specific hooks in
		the IP stack.

config LTQ_VOICE_CPE_TAPI_STATISTICS
	bool "TAPI statistics via /proc fs"
	depends on PACKAGE_ifx-voice-cpe-tapi
	default y
	help
		Option to enable /proc fs statistics for packet counts etc.

config LTQ_VOICE_CPE_TAPI_METERING
	bool "Metering (TTX) support"
	depends on PACKAGE_ifx-voice-cpe-tapi
	default n
	help
		Option to enable metering (TTX) support.

config LTQ_VOICE_CPE_TAPI_HDLC
	bool "PCM HDLC support, evaluation"
	depends on PACKAGE_ifx-voice-cpe-tapi
	default n
	help
		Option to enable PCM HDLC framing inside the firmware, e.g. for
		ISDN D-Channel access.

config LTQ_VOICE_CPE_TAPI_TRACES
	bool "enable driver traces"
	depends on PACKAGE_ifx-voice-cpe-tapi
	default y
	help
		enable driver traces with different trace levels to be
		configured dynamically from the application or during insmod

config LTQ_VOICE_CPE_TAPI_PHONE_DETECTION
	bool "FXS Phone Detection"
	depends on PACKAGE_ifx-voice-cpe-tapi
	default n
		help
			Option to use plugged Phone Detection on FXS line.

config LTQ_VOICE_CPE_TAPI_CONT_MEASUREMENT
	bool "Continuous Analog Line Measurement"
	depends on PACKAGE_ifx-voice-cpe-tapi
	default n
		help
			Option to use Continuous Measurement on FXS line.

config LTQ_VOICE_CPE_TAPI_PMC
	bool "Power Management Control support"
	depends on PACKAGE_ifx-voice-cpe-tapi
	depends on (LTQ_VOICE_CPE_TAPI_PHONE_DETECTION)
	depends on (TARGET_ltqcpe_platform_ar9 || TARGET_ltqcpe_platform_vr9)
	default n
		help
			Register with the Power Management Control Unit (PMCU)
			and enable/disable the power features.

config LTQ_VOICE_CPE_TAPI_EVENT_LOGGER
	bool "Event logger support"
	depends on PACKAGE_ifx-voice-cpe-tapi && +PACKAGE_ifx-evtlog
	default n
		help
			Option to enable detailed traces
			- for debugging only
			- requires package ifx-evtlog.
```

## package/infineon-utilities/feeds/ifx_voice_cpe/ifx-voice-cpe-tapidemo/config/Config.in
```kconfig
choice
   prompt "board selection"
   depends on PACKAGE_ifx-voice-cpe-tapidemo
   default LTQ_VOICE_CPE_TAPIDEMO_BOARD_EASY50712_V3  if (TARGET_ifxcpe_platform_danube || TARGET_ltqcpe_platform_danube)
   default LTQ_VOICE_CPE_TAPIDEMO_BOARD_EASY508xx     if (TARGET_ifxcpe_platform_ar9 || TARGET_ltqcpe_platform_ar9)
   default LTQ_VOICE_CPE_TAPIDEMO_BOARD_EASY80910     if (TARGET_ifxcpe_platform_vr9 || TARGET_ltqcpe_platform_vr9)
   default LTQ_VOICE_CPE_TAPIDEMO_BOARD_EASY50812
   help
      Select the target platform.

   config LTQ_VOICE_CPE_TAPIDEMO_BOARD_EASY50712
      bool "Danube reference board"

   config LTQ_VOICE_CPE_TAPIDEMO_BOARD_EASY50712_V3
      bool "Danube reference board V3"

   config LTQ_VOICE_CPE_TAPIDEMO_BOARD_EASY508xx
      bool "AR9/GR9 reference board"

   config LTQ_VOICE_CPE_TAPIDEMO_BOARD_EASY80910
      bool "VR9 reference board"
endchoice

menu "advanced configuration (for developers)"
   depends on PACKAGE_ifx-voice-cpe-tapidemo
config  LTQ_VOICE_CPE_TAPIDEMO_ADDITIONAL_FLAGS
	string "additional configuration arguments"
	depends on PACKAGE_ifx-voice-cpe-tapidemo
	default ""
	help
		additional configuration arguments (for developers)
endmenu

config LTQ_VOICE_CPE_TAPIDEMO_QOS
	bool "enable QOS support"
	depends on PACKAGE_ifx-voice-cpe-tapidemo
	default y
	help
		Option to enable the KPI2UDP RTP packet acceleration path
		(highly recommended for VoIP).

config  LTQ_VOICE_CPE_TAPIDEMO_FAX_MODEM
	bool "enable fax/modem transparent support"
	depends on PACKAGE_ifx-voice-cpe-tapidemo
   default y if LTQ_VOICE_CPE_TAPIDEMO_FAX_T_38_FW
	default n
	help
		enable fax/modem transparent support

config  LTQ_VOICE_CPE_TAPIDEMO_FAX_T_38_FW
	bool "enable T.38 fax relay"
	depends on PACKAGE_ifx-voice-cpe-tapidemo && (TARGET_ifxcpe_platform_ar9 || TARGET_ifxcpe_platform_vr9 || TARGET_ltqcpe_platform_ar9 || TARGET_ltqcpe_platform_vr9)
	default n
	help
		enable T.38 fax relay demo,
		when enabled then fax/modem transparent support is also enabled

config  LTQ_VOICE_CPE_TAPIDEMO_DXT_EXT
	bool "enable DuSLIC-xT extension board support"
	depends on PACKAGE_ifx-voice-cpe-tapidemo && PACKAGE_ifx-voice-cpe-tapi-duslic_xt && (TARGET_ifxcpe_platform_ar9 || TARGET_ifxcpe_platform_vr9 || TARGET_ltqcpe_platform_ar9 || TARGET_ltqcpe_platform_vr9)
	default y
	help
		enable DuSLIC-xT extension board support

config  LTQ_VOICE_CPE_TAPIDEMO_DECT
	bool "enable DECT support"
	depends on PACKAGE_ifx-dect && PACKAGE_ifx-voice-cpe-tapidemo && (TARGET_ifxcpe_platform_danube || TARGET_ifxcpe_platform_ar9 || TARGET_ifxcpe_platform_vr9 || TARGET_ltqcpe_platform_danube || TARGET_ltqcpe_platform_ar9 || TARGET_ltqcpe_platform_vr9)
	default y
	help
		enable DECT support.
```
